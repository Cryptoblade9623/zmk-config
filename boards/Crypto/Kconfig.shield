## boards/Crypto/Kconfig.shield
```kconfig
config SHIELD_CRYPTO_LEFT
    def_bool $(shields_list_contains,my_keyboard_left)

config SHIELD_CRYPTO_RIGHT
    def_bool $(shields_list_contains,my_keyboard_right)
```

## boards/shields/Crypto/Kconfig.shield
```kconfig
config SHIELD_CRYPTO_LEFT
    def_bool $(shields_list_contains,Crypto_left)

config SHIELD_CRYPTO_RIGHT
    def_bool $(shields_list_contains,Crypto_right)
```
